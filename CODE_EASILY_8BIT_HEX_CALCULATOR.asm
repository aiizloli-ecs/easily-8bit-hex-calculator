; HEX_CALCULATOR
	LIST		P=16F877A
	#INCLUDE	"P16F877A.INC"

; CREATE VARIABLE

UPPER1		EQU		0X50
LOWER1		EQU		0X51
UPPER2		EQU		0X52
LOWER2		EQU		0X53
NUM1			EQU		0X54
NUM2			EQU		0X55
TEMP_NUM2	EQU		0X56
RESULT_U		EQU		0X57
RESULT_L		EQU		0X58
SIGN			EQU		0X59
DL_M			EQU		0X60
DL_N			EQU		0X61

; SET VARIABLE

				CALL		CLEAR_VARIABLE

;==============================================

; CONFIGURING AS INPUT AND OUTPUT PORTS

	; SELECT BANK1
				BSF		STATUS, RP0
	
		; FOR KEYPAD CONFIG
				BSF		TRISC, 0
				BSF		TRISC, 1
				BSF		TRISC, 2
				BSF		TRISC, 3

				MOVLW	0XC0
				MOVWF	TRISB

		; FOR LCD CONFIG
				BCF		TRISC, 5
				BCF		TRISC, 6
				BCF		TRISC, 7

		; FOR LCD OUTPUT
				MOVLW	0X00
				MOVWF	TRISD

	; SELECT BANK0
				BCF		STATUS, RP0

;==============================================

; MAIN FUNCTION
MAIN			CALL		CHECK_KEYPAD
				GOTO		MAIN
				
;==============================================

CHECK_KEYPAD

	; SCAN THE 1ST COLUMN OF KEYS
				BSF		PORTB, 0

		; HAS THE 0 KEY BEEN PRSSED ? 
				BTFSC		PORTC, 0
				CALL		ZERO

		; HAS THE 4 KEY BEEN PRESSED ?
				BTFSC		PORTC, 1
				CALL		FOUR

		; HAS THE 8 KEY BEEN PRESSED ?
				BTFSC		PORTC, 2
				CALL		EIGHT

		; HAS THE 12 KEY BEEN PRESSED ?
				BTFSC		PORTC, 3
				CALL		TWELVE
	
				BCF		PORTB, 0
	;---------------------------------------------------------------------

	; SCAN THE 2ND COLUMN OF KEYS
				BSF		PORTB, 1

		; HAS THE 1 KEY BEEN PRSSED ? 
				BTFSC		PORTC, 0
				CALL		ONE

		; HAS THE 5 KEY BEEN PRESSED ?
				BTFSC		PORTC, 1
				CALL		FIVE

		; HAS THE 9 KEY BEEN PRESSED ?
				BTFSC		PORTC, 2
				CALL		NINE

		; HAS THE 13 KEY BEEN PRESSED ?
				BTFSC		PORTC, 3
				CALL		THIRTEEN

				BCF		PORTB, 1
	;---------------------------------------------------------------------

	; SCAN THE 3RD COLUMN OF KEYS
				BSF		PORTB, 2

		; HAS THE 2 KEY BEEN PRSSED ? 
				BTFSC		PORTC, 0
				CALL		TWO

		; HAS THE 6 KEY BEEN PRESSED ?
				BTFSC		PORTC, 1
				CALL		SIX

		; HAS THE 10 KEY BEEN PRESSED ?
				BTFSC		PORTC, 2
				CALL		TEN

		; HAS THE 14 KEY BEEN PRESSED ?
				BTFSC		PORTC, 3
				CALL		FOURTEEN

				BCF		PORTB, 2
	;---------------------------------------------------------------------

	; SCAN THE 4TH COLUMN OF KEYS
				BSF		PORTB, 3

		; HAS THE 3 KEY BEEN PRSSED ? 
				BTFSC		PORTC, 0
				CALL		THREE

		; HAS THE 7 KEY BEEN PRESSED ?
				BTFSC		PORTC, 1
				CALL		SEVEN

		; HAS THE 11 KEY BEEN PRESSED ?
				BTFSC		PORTC, 2
				CALL		ELEVEN

		; HAS THE 15 KEY BEEN PRESSED ?
				BTFSC		PORTC, 3
				CALL		FIFTEEN

				BCF		PORTB, 3
	;---------------------------------------------------------------------

	; SCAN THE 5TH COLUMN OF KEYS
				BSF		PORTB, 4

		; HAS THE * KEY BEEN PRSSED ? 
				BTFSC		PORTC, 0
				CALL		MUL

		; HAS THE LEFT-SHIFT KEY BEEN PRESSED ?
				BTFSC		PORTC, 1
				CALL		LSHIFT

		; HAS THE PLUS KEY BEEN PRESSED ?
				BTFSC		PORTC, 2
				CALL		PLUS

		; HAS THE PLUS KEY BEEN PRESSED ?
				BTFSC		PORTC, 3
				CALL		PLUS

				BCF		PORTB, 4
	;---------------------------------------------------------------------

	; SCAN THE 6TH COLUMN OF KEYS
				BSF		PORTB, 5

		; HAS THE ON/OFF KEY BEEN PRSSED ? 
				BTFSC		PORTC, 0
				CALL		ON

		; HAS THE RIGHT-SHIFT KEY BEEN PRESSED ?
				BTFSC		PORTC, 1
				CALL		RSHIFT

		; HAS THE MINUS KEY BEEN PRESSED ?
				BTFSC		PORTC, 2
				CALL		MINUS

		; HAS THE EQUAL KEY BEEN PRESSED ?
				BTFSC 		PORTC, 3
				CALL		EQUAL

				BCF		PORTB, 5
	;---------------------------------------------------------------------
				RETURN  ; RETURN TO MAIN FUNCTION

;==============================================

; KEY FUNCTION

ZERO			MOVLW	0X00
				CALL		STORE_DATA	
DISPLAY_ZERO
				MOVLW	0X30  ; ASCII '0'
				CALL		DISPLAY_DIGIT
				RETURN
	
ONE			MOVLW	0X01
				CALL		STORE_DATA
DISPLAY_ONE	
				MOVLW	0X31  ; ASCII '1'
				CALL		DISPLAY_DIGIT
				RETURN 
				
TWO			MOVLW	0X02
				CALL		STORE_DATA
DISPLAY_TWO	
				MOVLW	0X32  ; ASCII '2'
				CALL		DISPLAY_DIGIT
				RETURN 
				
THREE			MOVLW	0X03
				CALL		STORE_DATA
DISPLAY_THREE
				MOVLW	0X33  ; ASCII '3'
				CALL		DISPLAY_DIGIT
				RETURN 
				
FOUR			MOVLW	0X04
				CALL		STORE_DATA
DISPLAY_FOUR
				MOVLW	0X34  ; ASCII '4'
				CALL		DISPLAY_DIGIT
				RETURN 
				
FIVE			MOVLW	0X05
				CALL		STORE_DATA
DISPLAY_FIVE
				MOVLW	0X35  ; ASCII '5'
				CALL		DISPLAY_DIGIT
				RETURN 
				
SIX				MOVLW	0X06
				CALL		STORE_DATA
DISPLAY_SIX
				MOVLW	0X36  ; ASCII '6'
				CALL		DISPLAY_DIGIT
				RETURN 
				
SEVEN			MOVLW	0X07
				CALL		STORE_DATA
DISPLAY_SEVEN
				MOVLW	0X37  ; ASCII '7'
				CALL		DISPLAY_DIGIT
				RETURN 
				
EIGHT			MOVLW	0X08
				CALL		STORE_DATA
DISPLAY_EIGHT
				MOVLW	0X38  ; ASCII '8'
				CALL		DISPLAY_DIGIT
				RETURN 
				
NINE			MOVLW	0X09
				CALL		STORE_DATA
DISPLAY_NINE
				MOVLW	0X39  ; ASCII '9'
				CALL		DISPLAY_DIGIT
				RETURN 
	
TEN			MOVLW	0X0A
				CALL		STORE_DATA
DISPLAY_TEN
				MOVLW	0X41  ; ASCII 'A'
				CALL		DISPLAY_DIGIT
				RETURN

ELEVEN		MOVLW	0X0B
				CALL		STORE_DATA
DISPLAY_ELEVEN
				MOVLW	0X42  ; ASCII 'B'
				CALL		DISPLAY_DIGIT
				RETURN

TWELVE		MOVLW	0X0C
				CALL		STORE_DATA
DISPLAY_TWELVE
				MOVLW	0X43  ; ASCII 'C'
				CALL		DISPLAY_DIGIT
				RETURN

THIRTEEN		MOVLW	0X0D
				CALL		STORE_DATA
DISPLAY_THIRTEEN
				MOVLW	0X44  ; ASCII 'D'
				CALL		DISPLAY_DIGIT
				RETURN

FOURTEEN		MOVLW	0X0E
				CALL		STORE_DATA
DISPLAY_FOURTEEN
				MOVLW	0X45  ; ASCII 'E'
				CALL		DISPLAY_DIGIT
				RETURN

FIFTEEN		MOVLW	0X0F
				CALL		STORE_DATA
DISPLAY_FIFTEEN
				MOVLW	0X46  ; ASCII 'F'
				CALL		DISPLAY_DIGIT
				RETURN

;-----------------------------------------------------------------------

; FUNCTION
PLUS			MOVLW	0X10  ; 'xxx1 xx00'
				MOVWF	SIGN
				MOVLW	0X2B  ; ASCII '+'
				CALL		DISPLAY_DIGIT
				RETURN

MINUS			MOVLW	0X11  ; 'xxx1 xx01'
				MOVWF	SIGN
				MOVLW	0X2D  ; ASCII '-'
				CALL		DISPLAY_DIGIT
				RETURN

MUL			MOVLW	0X12  ;  'xxx1 xx10'
				MOVWF	SIGN
				MOVLW	0X78  ; ASCII 'x'
				CALL		DISPLAY_DIGIT
				RETURN

LSHIFT			MOVLW	0X3C
				CALL		DISPLAY_DIGIT

				BCF		STATUS, C
				RLF		RESULT_L, F
				BTFSC		RESULT_L, 4
				BSF		STATUS, C
				BCF		RESULT_L, 4
				RLF		RESULT_U, F
				BCF		RESULT_U, 4

				MOVF		RESULT_U, W
				CALL		DIGIT_N
				MOVF		RESULT_L, W
				CALL		DIGIT_N
				BCF		STATUS, C
				RETURN

RSHIFT			MOVLW	0X3E
				CALL		DISPLAY_DIGIT

				BCF		STATUS, C
				RRF		RESULT_U, F
				BTFSC		STATUS, C
				BSF		RESULT_L, 4
				BCF		STATUS, C
				RRF		RESULT_L, F
				BCF		STATUS, C

				MOVF		RESULT_U, W
				CALL		DIGIT_N
				MOVF		RESULT_L, W
				CALL		DIGIT_N
				BCF		STATUS, C
				RETURN

EQUAL			MOVLW	0X3D
				CALL		DISPLAY_DIGIT
				GOTO		CONDITION
				RETURN

ON				MOVLW	0X01
				CALL		DISPLAY
				CALL		CLEAR_VARIABLE
				RETURN

;============================================

CLEAR_VARIABLE
				CLRF		UPPER1
				CLRF		LOWER1
				CLRF		UPPER2
				CLRF		LOWER2
				CLRF		NUM1
				CLRF		NUM2
				CLRF		TEMP_NUM2
				CLRF		RESULT_U
				CLRF		RESULT_L
				CLRF		SIGN
				CLRF		DL_M
				CLRF		DL_N	
				RETURN

;=============================================

DIGIT_N		ADDWF		PCL, F
				GOTO		DISPLAY_ZERO
				GOTO		DISPLAY_ONE
				GOTO		DISPLAY_TWO
				GOTO		DISPLAY_THREE
				GOTO		DISPLAY_FOUR
				GOTO		DISPLAY_FIVE
				GOTO		DISPLAY_SIX
				GOTO		DISPLAY_SEVEN
				GOTO		DISPLAY_EIGHT
				GOTO		DISPLAY_NINE
				GOTO		DISPLAY_TEN
				GOTO		DISPLAY_ELEVEN
				GOTO		DISPLAY_TWELVE
				GOTO		DISPLAY_THIRTEEN
				GOTO		DISPLAY_FOURTEEN
				GOTO		DISPLAY_FIFTEEN

;==============================================

CONDITION	BTFSS		SIGN, 1
				GOTO		PLUS_MINUS_FN
				GOTO		MUL_FN
					
PLUS_MINUS_FN
				BTFSS		SIGN, 0
				GOTO		PLUS_FN
				GOTO		MINUS_FN

PLUS_FN		MOVF		LOWER2, W
				ADDWF		LOWER1, W
				MOVWF	RESULT_L
				BTFSC		RESULT_L, 4
				INCF		UPPER2, F
				BCF		RESULT_L, 4
				MOVF		UPPER2, W
				ADDWF		UPPER1, W

				MOVWF	RESULT_U
				CALL		DIGIT_N
				MOVF		RESULT_L, W
				CALL		DIGIT_N

				CALL		NEW_DATA
				RETURN
				
MINUS_FN		MOVF		LOWER2, W
				SUBWF		LOWER1, W
				MOVWF	RESULT_L
				BTFSC		RESULT_L, 7
				DECF		UPPER1, F
				MOVLW	0X0F
				ANDWF		RESULT_L, F  ; CLEAR BIT7 - BIT4
				MOVF		UPPER2, W
				SUBWF		UPPER1, W

				MOVWF	RESULT_U
				CALL		DIGIT_N
				MOVF		RESULT_L, W
				CALL		DIGIT_N

				CALL		NEW_DATA
				RETURN

MUL_FN		MOVF		NUM2, W
				MOVWF	TEMP_NUM2
				MOVF		UPPER1, W
				MOVWF	RESULT_U
				MOVF		LOWER1, W
				MOVWF	RESULT_L

LOOP_LO		DECF		TEMP_NUM2, F
				BTFSC		STATUS, Z  ; 0 SKIPED
				GOTO		$+6
				ADDWF		RESULT_L, F
				BTFSC		STATUS, C
				INCF		RESULT_U, F
				BCF		STATUS, C
				GOTO		LOOP_LO

				MOVF		NUM2, W
				MOVWF	TEMP_NUM2
				MOVF		UPPER1, W
				; W = UPPER1
LOOP_UP		DECF		TEMP_NUM2, F
				BTFSC		STATUS, Z
				GOTO		$+3
				ADDWF		RESULT_U, F
				GOTO		LOOP_UP

				MOVF		RESULT_U, W
				CALL		DIGIT_N
				MOVF		RESULT_L, W
				CALL		DIGIT_N

				CALL		NEW_DATA
				RETURN

;==============================================

STORE_DATA	BTFSS		SIGN, 4
				GOTO		NUM1_FN
				GOTO		NUM2_FN
			
NUM1_FN		BTFSS		SIGN, 7
				GOTO		LOWER1_FN
				GOTO		UPPER1_FN

NUM2_FN		BTFSS		SIGN, 6
				GOTO		LOWER2_FN
				GOTO		UPPER2_FN

LOWER1_FN	MOVWF	LOWER1
				MOVWF	NUM1
				MOVWF	RESULT_L
				BSF		SIGN, 7
				RETURN

UPPER1_FN	MOVWF	RESULT_L
				MOVF		LOWER1, W
				MOVWF	UPPER1
				MOVWF	RESULT_U
				MOVF		RESULT_L, W
				MOVWF	LOWER1

				SWAPF		UPPER1, W
				IORWF		LOWER1, W
				MOVWF	NUM1
				BCF		SIGN, 7
				RETURN

LOWER2_FN	MOVWF	LOWER2
				MOVWF	NUM2
				MOVWF	RESULT_L
				BSF		SIGN, 6
				RETURN

UPPER2_FN	MOVWF	RESULT_L
				MOVF		LOWER2, W
				MOVWF	UPPER2
				MOVWF	RESULT_U
				MOVF		RESULT_L, W
				MOVWF	LOWER2

				SWAPF		UPPER2, W
				IORWF		LOWER2, W
				MOVWF	NUM2
				BCF		SIGN, 6
				RETURN
	
NEW_DATA	MOVF		RESULT_U, W
				MOVWF	UPPER1
				MOVF		RESULT_L, W
				MOVWF	LOWER1
				CLRF		SIGN
				RETURN
;==============================================

; DISPLAY THE DIGIT IN THE 7SEGMENT
	; IF
		; RS=0  INSTRUCTION COMMAND CODE REGISTER IS SELECTED, ALLOWING USER TO SEND COMMAND
		; RS=1  DATA REGISTER IS SELECTED ALLOWING TO SEND DATA THAT HAS TO BE DISPLAYED.

		; R\W=0  READING
		; R\W=1  WRITING
		; E- ENABLE

		; THE ENABLE PIN IS USED BY THE LCD TO LATCH INFORMATION AT ITS DATA PINS. WHEN DATA IS SUPPLIED TO DATA PINS,
		; A HIGH TO LOW PULSE MUST BE APPLIED TO THIS PIN IN ORDER FOR THE LCD TO LATCH THE DATA PRESENT IN THE DATA PINS.
		; E SHOULD  TOGGLE

		; DATA MODE:  RS=1, R\W=0, E=1\0

DISPLAY_DIGIT
				BSF		PORTC, 5  ; CONTROL SIGNAL TO RS
				BCF		PORTC, 6  ; CONTROL SIGNAL TO R/W
				BSF		PORTC, 7  ; CONTROL SIGNAL TO ENABLE

				CALL		DISPLAY
			
				MOVLW	0X38  ; INITIALISES THE DISPLAY
				CALL		DISPLAY

				MOVLW	0X0E  ; DON'T BLINK THE CURSOR
				CALL		DISPLAY

				BSF		PORTC, 5
				RETURN

DISPLAY		MOVWF	PORTD 
			; SEND DATA TO DATA PINS
				BCF		PORTC, 7
				CALL		DELAY

				BSF		PORTC, 7
				CALL		DELAY
			; SELECT COMMAND REGISTER
				BCF		PORTC, 5
				RETURN

DELAY			MOVLW	0X0D  ; VERY SMALL DELAY
				MOVWF	DL_N
				MOVLW	0XFB
				MOVWF	DL_M		
LOOP			DECFSZ	DL_M
				GOTO		LOOP
				DECFSZ	DL_N
				GOTO		LOOP
				RETURN
				END